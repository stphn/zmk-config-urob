## config/boards/arm/cc36/Kconfig.board
```kconfig
# Copyright (c) 2020 The ZMK Contributors
# SPDX-License-Identifier: MIT

config BOARD_CC36_LEFT
	bool "CC36 Left"
	depends on SOC_NRF52840_QIAA

config BOARD_CC36_RIGHT
    bool "CC36 Right"
    depends on SOC_NRF52840_QIAA
```
